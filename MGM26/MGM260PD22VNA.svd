# MGM260PD22VNA register map
Vendor: Silicon Labs; Series: EFR32; File version: 2
MGM260PD22VNA2, Multiprotocol Module, 2.4 GHz, 3200kB Flash, 512kB RAM, Built-in Antenna, Secure Vault High, MVP, +10 dBm, -40 to +105C, PCB, Certified/FP
Registers are 32-bit, read-write, reset 0x0 unless marked. A register's access mark holds for its fields unless they carry their own. Offsets are from the block's base; lines under a group give offsets from that group; [hi:lo] are bit positions; {n}, {i} and the like mark numbered series; 'fields as' and 'values as' point back to an identical list; <NAME> marks a mode.

## Memory map
0x0FE08000 DEVINFO size 0x1000 — DEVINFO Registers
0x40004000 EMU_S size 0x1000 — EMU_S Registers
0x40008000 CMU_S size 0x1000 — CMU_S Registers
0x4000C000 BURTC_S size 0x1000 — BURTC_S Registers
0x40010000 HFRCO0_S size 0x1000 — HFRCO0_S Registers
0x40018000 FSRCO_S size 0x1000 — FSRCO_S Registers
0x4001C000 DPLL0_S size 0x1000 — DPLL0_S Registers
0x40020000 LFXO_S size 0x1000 — LFXO_S Registers
0x40024000 LFRCO_S size 0x1000 — LFRCO_S Registers
0x40028000 ULFRCO_S size 0x1000 — ULFRCO_S Registers
0x4002C000 KEYSCAN_S size 0x1000 — KEYSCAN_S Registers
0x40030000 MSC_S size 0x1000 — MSC_S Registers
0x40034000 ICACHE0_S size 0x1000 — ICACHE0_S Registers
0x40038000 PRS_S size 0x1000 — PRS_S Registers
0x4003C000 GPIO_S size 0x1000 — GPIO_S Registers
0x40040000 LDMA_S size 0x1000 — LDMA_S Registers
0x40044000 LDMAXBAR_S size 0x1000 — LDMAXBAR_S Registers
{0x40048000+0x4000*n} TIMER{n}_S size 0x1000 (n=0..9) — TIMER{n}_S Registers
0x40074000 DMEM0_S size 0x1000 — DMEM0_S Registers
0x40078000 DMEM1_S size 0x1000 — DMEM1_S Registers
0x4007C000 SYSCFG_S_CFGNS size 0x1000 — SYSCFG_S_CFGNS Registers
0x40080000 SYSCFG_S size 0x1000 — SYSCFG_S Registers
0x40084000 BURAM_S size 0x1000 — BURAM_S Registers
0x40088000 GPCRC_S size 0x1000 — GPCRC_S Registers
0x4008C000 EUSART1_S size 0x1000 — EUSART1_S Registers
0x40090000 EUSART2_S size 0x1000 — EUSART2_S Registers
0x40094000 EUSART3_S size 0x1000 — EUSART3_S Registers
0x40098000 DCDC_S size 0x1000 — DCDC_S Registers
0x4009C000 HOSTMAILBOX_S size 0x1000 — HOSTMAILBOX_S Registers
0x400A0000 USART0_S size 0x1000 — USART0_S Registers
0x400A4000 USART1_S size 0x1000 — USART1_S Registers
0x400A8000 USART2_S size 0x1000 — USART2_S Registers
0x400AC000 SYSRTC0_S size 0x1000 — SYSRTC0_S Registers
0x400B0000 I2C1_S size 0x1000 — I2C1_S Registers
0x400B4000 I2C2_S size 0x1000 — I2C2_S Registers
0x400B8000 I2C3_S size 0x1000 — I2C3_S Registers
0x400BC000 LCD_S size 0x1000 — LCD_S Registers
0x400C0000 LCDRF_S size 0x1000 — LCDRF_S Registers
0x44000000 RADIOAES_S size 0x1000 — RADIOAES_S Registers
0x44008000 SMU_S size 0x1000 — SMU_S Registers
0x4400C000 SMU_S_CFGNS size 0x1000 — SMU_S_CFGNS Registers
0x49000000 LETIMER0_S size 0x1000 — LETIMER0_S Registers
0x49004000 IADC0_S size 0x1000 — IADC0_S Registers
0x49008000 ACMP0_S size 0x1000 — ACMP0_S Registers
0x4900C000 ACMP1_S size 0x1000 — ACMP1_S Registers
0x49020000 AMUXCP0_S size 0x1000 — AMUXCP0_S Registers
0x49024000 VDAC0_S size 0x1000 — VDAC0_S Registers
0x49028000 VDAC1_S size 0x1000 — VDAC1_S Registers
0x49030000 PCNT0_S size 0x1000 — PCNT0_S Registers
0x4A000000 HFRCOEM23_S size 0x1000 — HFRCOEM23_S Registers
0x4A004000 HFXO0_S size 0x1000 — HFXO0_S Registers
0x4B000000 I2C0_S size 0x1000 — I2C0_S Registers
0x4B004000 WDOG0_S size 0x1000 — WDOG0_S Registers
0x4B008000 WDOG1_S size 0x1000 — WDOG1_S Registers
0x4B010000 EUSART0_S size 0x1000 — EUSART0_S Registers
0x4C000000 SEMAILBOX_S_HOST size 0x1000 — SEMAILBOX_S_HOST Registers
0x4D000000 MVP_S size 0x1000 — MVP_S Registers
0x50004000 EMU_NS size 0x1000 — EMU_NS Registers
0x50008000 CMU_NS size 0x1000 — CMU_NS Registers
0x5000C000 BURTC_NS size 0x1000 — BURTC_NS Registers
0x50010000 HFRCO0_NS size 0x1000 — HFRCO0_NS Registers
0x50018000 FSRCO_NS size 0x1000 — FSRCO_NS Registers
0x5001C000 DPLL0_NS size 0x1000 — DPLL0_NS Registers
0x50020000 LFXO_NS size 0x1000 — LFXO_NS Registers
0x50024000 LFRCO_NS size 0x1000 — LFRCO_NS Registers
0x50028000 ULFRCO_NS size 0x1000 — ULFRCO_NS Registers
0x5002C000 KEYSCAN_NS size 0x1000 — KEYSCAN_NS Registers
0x50030000 MSC_NS size 0x1000 — MSC_NS Registers
0x50034000 ICACHE0_NS size 0x1000 — ICACHE0_NS Registers
0x50038000 PRS_NS size 0x1000 — PRS_NS Registers
0x5003C000 GPIO_NS size 0x1000 — GPIO_NS Registers
0x50040000 LDMA_NS size 0x1000 — LDMA_NS Registers
0x50044000 LDMAXBAR_NS size 0x1000 — LDMAXBAR_NS Registers
{0x50048000+0x4000*n} TIMER{n}_NS size 0x1000 (n=0..9) — TIMER{n}_NS Registers
0x50074000 DMEM0_NS size 0x1000 — DMEM0_NS Registers
0x50078000 DMEM1_NS size 0x1000 — DMEM1_NS Registers
0x5007C000 SYSCFG_NS_CFGNS size 0x1000 — SYSCFG_NS_CFGNS Registers
0x50080000 SYSCFG_NS size 0x1000 — SYSCFG_NS Registers
0x50084000 BURAM_NS size 0x1000 — BURAM_NS Registers
0x50088000 GPCRC_NS size 0x1000 — GPCRC_NS Registers
0x5008C000 EUSART1_NS size 0x1000 — EUSART1_NS Registers
0x50090000 EUSART2_NS size 0x1000 — EUSART2_NS Registers
0x50094000 EUSART3_NS size 0x1000 — EUSART3_NS Registers
0x50098000 DCDC_NS size 0x1000 — DCDC_NS Registers
0x5009C000 HOSTMAILBOX_NS size 0x1000 — HOSTMAILBOX_NS Registers
0x500A0000 USART0_NS size 0x1000 — USART0_NS Registers
0x500A4000 USART1_NS size 0x1000 — USART1_NS Registers
0x500A8000 USART2_NS size 0x1000 — USART2_NS Registers
0x500AC000 SYSRTC0_NS size 0x1000 — SYSRTC0_NS Registers
0x500B0000 I2C1_NS size 0x1000 — I2C1_NS Registers
0x500B4000 I2C2_NS size 0x1000 — I2C2_NS Registers
0x500B8000 I2C3_NS size 0x1000 — I2C3_NS Registers
0x500BC000 LCD_NS size 0x1000 — LCD_NS Registers
0x500C0000 LCDRF_NS size 0x1000 — LCDRF_NS Registers
0x54000000 RADIOAES_NS size 0x1000 — RADIOAES_NS Registers
0x54008000 SMU_NS size 0x1000 — SMU_NS Registers
0x5400C000 SMU_NS_CFGNS size 0x1000 — SMU_NS_CFGNS Registers
0x59000000 LETIMER0_NS size 0x1000 — LETIMER0_NS Registers
0x59004000 IADC0_NS size 0x1000 — IADC0_NS Registers
0x59008000 ACMP0_NS size 0x1000 — ACMP0_NS Registers
0x5900C000 ACMP1_NS size 0x1000 — ACMP1_NS Registers
0x59020000 AMUXCP0_NS size 0x1000 — AMUXCP0_NS Registers
0x59024000 VDAC0_NS size 0x1000 — VDAC0_NS Registers
0x59028000 VDAC1_NS size 0x1000 — VDAC1_NS Registers
0x59030000 PCNT0_NS size 0x1000 — PCNT0_NS Registers
0x5A000000 HFRCOEM23_NS size 0x1000 — HFRCOEM23_NS Registers
0x5A004000 HFXO0_NS size 0x1000 — HFXO0_NS Registers
0x5B000000 I2C0_NS size 0x1000 — I2C0_NS Registers
0x5B004000 WDOG0_NS size 0x1000 — WDOG0_NS Registers
0x5B008000 WDOG1_NS size 0x1000 — WDOG1_NS Registers
0x5B010000 EUSART0_NS size 0x1000 — EUSART0_NS Registers
0x5C000000 SEMAILBOX_NS_HOST size 0x1000 — SEMAILBOX_NS_HOST Registers
0x5D000000 MVP_NS size 0x1000 — MVP_NS Registers

## Interrupts
0 SMU_SECURE (SMU_NS, SMU_NS_CFGNS, SMU_S, SMU_S_CFGNS)
1 SMU_S_PRIVILEGED (SMU_NS, SMU_NS_CFGNS, SMU_S, SMU_S_CFGNS)
3 EMU (EMU_NS, EMU_S)
{n+4} TIMER{n} (TIMER{n}_NS, TIMER{n}_S) (n=0..9)
14 USART0_RX (USART0_NS, USART0_S)
15 USART0_TX (USART0_NS, USART0_S)
16 USART1_RX (USART1_NS, USART1_S)
17 USART1_TX (USART1_NS, USART1_S)
18 USART2_RX (USART2_NS, USART2_S)
19 USART2_TX (USART2_NS, USART2_S)
20 EUSART0_RX (EUSART0_NS, EUSART0_S)
21 EUSART0_TX (EUSART0_NS, EUSART0_S)
22 EUSART1_RX (EUSART1_NS, EUSART1_S)
23 EUSART1_TX (EUSART1_NS, EUSART1_S)
24 EUSART2_RX (EUSART2_NS, EUSART2_S)
25 EUSART2_TX (EUSART2_NS, EUSART2_S)
26 EUSART3_RX (EUSART3_NS, EUSART3_S)
27 EUSART3_TX (EUSART3_NS, EUSART3_S)
28 MVP (MVP_NS, MVP_S)
29 ICACHE0 (ICACHE0_NS, ICACHE0_S)
30 BURTC (BURTC_NS, BURTC_S)
31 LETIMER0 (LETIMER0_NS, LETIMER0_S)
32 SYSCFG (SYSCFG_NS, SYSCFG_NS_CFGNS, SYSCFG_S, SYSCFG_S_CFGNS)
35 LDMA (LDMA_NS, LDMA_S)
36 LFXO (LFXO_NS, LFXO_S)
37 LFRCO (LFRCO_NS, LFRCO_S)
38 ULFRCO (ULFRCO_NS, ULFRCO_S)
39 GPIO_ODD (GPIO_NS, GPIO_S)
40 GPIO_EVEN (GPIO_NS, GPIO_S)
41 I2C0 (I2C0_NS, I2C0_S)
42 I2C1 (I2C1_NS, I2C1_S)
43 I2C2 (I2C2_NS, I2C2_S)
44 I2C3 (I2C3_NS, I2C3_S)
45 EMUDG (EMU_NS, EMU_S)
54 HOSTMAILBOX (HOSTMAILBOX_NS, HOSTMAILBOX_S)
56 ACMP0 (ACMP0_NS, ACMP0_S)
57 ACMP1 (ACMP1_NS, ACMP1_S)
58 WDOG0 (WDOG0_NS, WDOG0_S)
59 WDOG1 (WDOG1_NS, WDOG1_S)
60 HFXO0 (HFXO0_NS, HFXO0_S)
61 HFRCO0 (HFRCO0_NS, HFRCO0_S)
62 HFRCOEM23 (HFRCOEM23_NS, HFRCOEM23_S)
63 CMU (CMU_NS, CMU_S)
64 AES (RADIOAES_NS, RADIOAES_S)
65 IADC (IADC0_NS, IADC0_S)
66 MSC (MSC_NS, MSC_S)
67 DPLL0 (DPLL0_NS, DPLL0_S)
69 DCDC (DCDC_NS, DCDC_S)
70 PCNT0 (PCNT0_NS, PCNT0_S)
71 SW0 (SYSCFG_NS, SYSCFG_NS_CFGNS, SYSCFG_S, SYSCFG_S_CFGNS)
72 SW1 (SYSCFG_NS, SYSCFG_NS_CFGNS, SYSCFG_S, SYSCFG_S_CFGNS)
73 SW2 (SYSCFG_NS, SYSCFG_NS_CFGNS, SYSCFG_S, SYSCFG_S_CFGNS)
74 SW3 (SYSCFG_NS, SYSCFG_NS_CFGNS, SYSCFG_S, SYSCFG_S_CFGNS)
81 SEMBRX (SEMAILBOX_NS_HOST, SEMAILBOX_S_HOST)
82 SEMBTX (SEMAILBOX_NS_HOST, SEMAILBOX_S_HOST)
83 SYSRTC_APP (SYSRTC0_NS, SYSRTC0_S)
84 SYSRTC_SEQ (SYSRTC0_NS, SYSRTC0_S)
85 KEYSCAN (KEYSCAN_NS, KEYSCAN_S)
88 VDAC0 (VDAC0_NS, VDAC0_S)
89 VDAC1 (VDAC1_NS, VDAC1_S)
92 LCD (LCD_NS, LCD_S)

## Further device data
name=Copyright 2026 Silicon Laboratories, Inc., ramBaseAddress=0x20000000, ramSize=0x00080000, ramAccessTypes=rwx, ramBaseAddress=0x20040000, ramSize=0x00080000, ramAccessTypes=rwx, seqram_s_BaseAddress=0xA0000000, seqram_s_Size=0x00004000, seqram_s_AccessTypes=rwx, frcram_s_BaseAddress=0xA0004000, frcram_s_Size=0x00001000, frcram_s_AccessTypes=rwx, seqram_ns_BaseAddress=0xB0000000, seqram_ns_Size=0x00004000, seqram_ns_AccessTypes=rwx, frcram_ns_BaseAddress=0xB0004000, frcram_ns_Size=0x00001000, frcram_ns_AccessTypes=rwx
