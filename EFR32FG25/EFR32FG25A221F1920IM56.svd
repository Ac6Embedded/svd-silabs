# EFR32FG25A221F1920IM56 register map
Vendor: Silicon Labs; Series: EFR32; File version: B
Registers are 32-bit, read-write, reset 0x0 unless marked. A register's access mark holds for its fields unless they carry their own. Offsets are from the block's base; lines under a group give offsets from that group; [hi:lo] are bit positions; {n}, {i} and the like mark numbered series; 'fields as' and 'values as' point back to an identical list; <NAME> marks a mode.

## Memory map
0x0FE08000 DEVINFO size 0x1000 — DEVINFO Registers
0x40000000 SCRATCHPAD_S size 0x1000 — SCRATCHPAD_S Registers
0x40004000 EMU_S size 0x1000 — EMU_S Registers
0x40008000 CMU_S size 0x1000 — CMU_S Registers
0x40010000 HFRCO0_S size 0x1000 — HFRCO0_S Registers
0x40018000 FSRCO_S size 0x1000 — FSRCO_S Registers
0x4001C000 DPLL0_S size 0x1000 — DPLL0_S Registers
0x40020000 LFXO_S size 0x1000 — LFXO_S Registers
0x40024000 LFRCO_S size 0x1000 — LFRCO_S Registers
0x40028000 ULFRCO_S size 0x1000 — ULFRCO_S Registers
0x40030000 MSC_S size 0x1000 — MSC_S Registers
0x40034000 ICACHE0_S size 0x1000 — ICACHE0_S Registers
0x40038000 PRS_S size 0x1000 — PRS_S Registers
0x4003C000 GPIO_S size 0x1000 — GPIO_S Registers
0x40040000 LDMA_S size 0x1000 — LDMA_S Registers
0x40044000 LDMAXBAR_S size 0x1000 — LDMAXBAR_S Registers
{0x40048000+0x4000*n} TIMER{n}_S size 0x1000 (n=0..7) — TIMER{n}_S Registers
0x4006C000 BURTC_S size 0x1000 — BURTC_S Registers
0x40070000 I2C1_S size 0x1000 — I2C1_S Registers
0x40078000 SYSCFG_S_CFGNS size 0x1000 — SYSCFG_S_CFGNS Registers
0x4007C000 SYSCFG_S size 0x1000 — SYSCFG_S Registers
0x40080000 BURAM_S size 0x1000 — BURAM_S Registers
0x40088000 GPCRC_S size 0x1000 — GPCRC_S Registers
0x40094000 DCDC_S size 0x1000 — DCDC_S Registers
0x40098000 HOSTMAILBOX_S size 0x1000 — HOSTMAILBOX_S Registers
0x400A0000 EUSART1_S size 0x1000 — EUSART1_S Registers
0x400A4000 EUSART2_S size 0x1000 — EUSART2_S Registers
0x400A8000 EUSART3_S size 0x1000 — EUSART3_S Registers
0x400AC000 EUSART4_S size 0x1000 — EUSART4_S Registers
0x400B0000 SYSRTC0_S size 0x1000 — SYSRTC0_S Registers
0x400C0000 DMEM_S size 0x1000 — DMEM_S Registers
0x400C4000 PFMXPPRF_S size 0x1000 — PFMXPPRF_S Registers
0x400C8000 RFFPLL0_S size 0x1000 — RFFPLL0_S Registers
0x400D0000 ETAMPDET_S size 0x1000 — ETAMPDET_S Registers
0x42000000 BUFC_S size 0x1000 — BUFC_S Registers
0x44000000 RADIOAES_S size 0x1000 — RADIOAES_S Registers
0x44008000 SMU_S size 0x1000 — SMU_S Registers
0x4400C000 SMU_S_CFGNS size 0x1000 — SMU_S_CFGNS Registers
0x46000000 USBAHB_S_AHBS size 0x21000 — USBAHB_S_AHBS Registers
0x47000000 USB_S_APBS size 0x1000 — USB_S_APBS Registers
0x47004000 USBPLL0_S size 0x1000 — USBPLL0_S Registers
0x49000000 LETIMER0_S size 0x1000 — LETIMER0_S Registers
0x49004000 IADC0_S size 0x1000 — IADC0_S Registers
0x49008000 ACMP0_S size 0x1000 — ACMP0_S Registers
0x4900C000 ACMP1_S size 0x1000 — ACMP1_S Registers
0x49024000 VDAC0_S size 0x1000 — VDAC0_S Registers
0x49030000 PCNT0_S size 0x1000 — PCNT0_S Registers
0x49038000 LESENSE_S size 0x1000 — LESENSE_S Registers
0x4A000000 HFRCOEM23_S size 0x1000 — HFRCOEM23_S Registers
0x4A004000 HFXO0_S size 0x1000 — HFXO0_S Registers
0x4B000000 I2C0_S size 0x1000 — I2C0_S Registers
0x4B004000 WDOG0_S size 0x1000 — WDOG0_S Registers
0x4B008000 WDOG1_S size 0x1000 — WDOG1_S Registers
0x4B010000 EUSART0_S size 0x1000 — EUSART0_S Registers
0x4C000000 SEMAILBOX_S_HOST size 0x1000 — SEMAILBOX_S_HOST Registers
0x50000000 SCRATCHPAD_NS size 0x1000 — SCRATCHPAD_NS Registers
0x50004000 EMU_NS size 0x1000 — EMU_NS Registers
0x50008000 CMU_NS size 0x1000 — CMU_NS Registers
0x50010000 HFRCO0_NS size 0x1000 — HFRCO0_NS Registers
0x50018000 FSRCO_NS size 0x1000 — FSRCO_NS Registers
0x5001C000 DPLL0_NS size 0x1000 — DPLL0_NS Registers
0x50020000 LFXO_NS size 0x1000 — LFXO_NS Registers
0x50024000 LFRCO_NS size 0x1000 — LFRCO_NS Registers
0x50028000 ULFRCO_NS size 0x1000 — ULFRCO_NS Registers
0x50030000 MSC_NS size 0x1000 — MSC_NS Registers
0x50034000 ICACHE0_NS size 0x1000 — ICACHE0_NS Registers
0x50038000 PRS_NS size 0x1000 — PRS_NS Registers
0x5003C000 GPIO_NS size 0x1000 — GPIO_NS Registers
0x50040000 LDMA_NS size 0x1000 — LDMA_NS Registers
0x50044000 LDMAXBAR_NS size 0x1000 — LDMAXBAR_NS Registers
{0x50048000+0x4000*n} TIMER{n}_NS size 0x1000 (n=0..7) — TIMER{n}_NS Registers
0x5006C000 BURTC_NS size 0x1000 — BURTC_NS Registers
0x50070000 I2C1_NS size 0x1000 — I2C1_NS Registers
0x50078000 SYSCFG_NS_CFGNS size 0x1000 — SYSCFG_NS_CFGNS Registers
0x5007C000 SYSCFG_NS size 0x1000 — SYSCFG_NS Registers
0x50080000 BURAM_NS size 0x1000 — BURAM_NS Registers
0x50088000 GPCRC_NS size 0x1000 — GPCRC_NS Registers
0x50094000 DCDC_NS size 0x1000 — DCDC_NS Registers
0x50098000 HOSTMAILBOX_NS size 0x1000 — HOSTMAILBOX_NS Registers
0x500A0000 EUSART1_NS size 0x1000 — EUSART1_NS Registers
0x500A4000 EUSART2_NS size 0x1000 — EUSART2_NS Registers
0x500A8000 EUSART3_NS size 0x1000 — EUSART3_NS Registers
0x500AC000 EUSART4_NS size 0x1000 — EUSART4_NS Registers
0x500B0000 SYSRTC0_NS size 0x1000 — SYSRTC0_NS Registers
0x500C0000 DMEM_NS size 0x1000 — DMEM_NS Registers
0x500C4000 PFMXPPRF_NS size 0x1000 — PFMXPPRF_NS Registers
0x500C8000 RFFPLL0_NS size 0x1000 — RFFPLL0_NS Registers
0x500D0000 ETAMPDET_NS size 0x1000 — ETAMPDET_NS Registers
0x52000000 BUFC_NS size 0x1000 — BUFC_NS Registers
0x54000000 RADIOAES_NS size 0x1000 — RADIOAES_NS Registers
0x54008000 SMU_NS size 0x1000 — SMU_NS Registers
0x5400C000 SMU_NS_CFGNS size 0x1000 — SMU_NS_CFGNS Registers
0x56000000 USBAHB_NS_AHBS size 0x21000 — USBAHB_NS_AHBS Registers
0x57000000 USB_NS_APBS size 0x1000 — USB_NS_APBS Registers
0x57004000 USBPLL0_NS size 0x1000 — USBPLL0_NS Registers
0x59000000 LETIMER0_NS size 0x1000 — LETIMER0_NS Registers
0x59004000 IADC0_NS size 0x1000 — IADC0_NS Registers
0x59008000 ACMP0_NS size 0x1000 — ACMP0_NS Registers
0x5900C000 ACMP1_NS size 0x1000 — ACMP1_NS Registers
0x59024000 VDAC0_NS size 0x1000 — VDAC0_NS Registers
0x59030000 PCNT0_NS size 0x1000 — PCNT0_NS Registers
0x59038000 LESENSE_NS size 0x1000 — LESENSE_NS Registers
0x5A000000 HFRCOEM23_NS size 0x1000 — HFRCOEM23_NS Registers
0x5A004000 HFXO0_NS size 0x1000 — HFXO0_NS Registers
0x5B000000 I2C0_NS size 0x1000 — I2C0_NS Registers
0x5B004000 WDOG0_NS size 0x1000 — WDOG0_NS Registers
0x5B008000 WDOG1_NS size 0x1000 — WDOG1_NS Registers
0x5B010000 EUSART0_NS size 0x1000 — EUSART0_NS Registers
0x5C000000 SEMAILBOX_NS_HOST size 0x1000 — SEMAILBOX_NS_HOST Registers
0xA6020000 MPAHBRAM_S size 0x1000 — MPAHBRAM_S Registers
0xB6020000 MPAHBRAM_NS size 0x1000 — MPAHBRAM_NS Registers

## Interrupts
0 SMU_SECURE (SMU_NS, SMU_NS_CFGNS, SMU_S, SMU_S_CFGNS)
1 SMU_S_PRIVILEGED (SMU_NS, SMU_NS_CFGNS, SMU_S, SMU_S_CFGNS)
3 EMU (EMU_NS, EMU_S)
4 TIMER0 (TIMER0_NS, TIMER0_S)
5 TIMER1 (TIMER1_NS, TIMER1_S)
6 TIMER2 (TIMER2_NS, TIMER2_S)
7 TIMER3 (TIMER3_NS, TIMER3_S)
8 ETAMPDET (ETAMPDET_NS, ETAMPDET_S)
9 TIMER4 (TIMER4_NS, TIMER4_S)
10 TIMER5 (TIMER5_NS, TIMER5_S)
11 TIMER6 (TIMER6_NS, TIMER6_S)
12 TIMER7 (TIMER7_NS, TIMER7_S)
13 EUSART0_RX (EUSART0_NS, EUSART0_S)
14 EUSART0_TX (EUSART0_NS, EUSART0_S)
15 EUSART1_RX (EUSART1_NS, EUSART1_S)
16 EUSART1_TX (EUSART1_NS, EUSART1_S)
17 EUSART2_RX (EUSART1_NS, EUSART1_S)
18 EUSART2_TX (EUSART1_NS, EUSART1_S)
19 EUSART3_RX (EUSART3_NS, EUSART3_S)
20 EUSART3_TX (EUSART3_NS, EUSART3_S)
21 EUSART4_RX (EUSART4_NS, EUSART4_S)
22 EUSART4_TX (EUSART4_NS, EUSART4_S)
23 ICACHE0 (ICACHE0_NS, ICACHE0_S)
24 BURTC (BURTC_NS, BURTC_S)
25 LETIMER0 (LETIMER0_NS, LETIMER0_S)
26 SYSCFG (SYSCFG_NS, SYSCFG_NS_CFGNS, SYSCFG_S, SYSCFG_S_CFGNS)
27 MPAHBRAM (MPAHBRAM_NS, MPAHBRAM_S)
28 LDMA (LDMA_NS, LDMA_S)
29 LFXO (LFXO_NS, LFXO_S)
30 LFRCO (LFRCO_NS, LFRCO_S)
31 ULFRCO (ULFRCO_NS, ULFRCO_S)
32 GPIO_ODD (GPIO_NS, GPIO_S)
33 GPIO_EVEN (GPIO_NS, GPIO_S)
34 I2C0 (I2C0_NS, I2C0_S)
35 I2C1 (I2C1_NS, I2C1_S)
36 EMUDG (EMU_NS, EMU_S)
38 BUFC (BUFC_NS, BUFC_S)
45 HOSTMAILBOX (HOSTMAILBOX_NS, HOSTMAILBOX_S)
47 ACMP0 (ACMP0_NS, ACMP0_S)
48 ACMP1 (ACMP1_NS, ACMP1_S)
49 WDOG0 (WDOG0_NS, WDOG0_S)
50 WDOG1 (WDOG1_NS, WDOG1_S)
51 HFXO0 (HFXO0_NS, HFXO0_S)
52 HFRCO0 (HFRCO0_NS, HFRCO0_S)
53 HFRCOEM23 (HFRCOEM23_NS, HFRCOEM23_S)
54 CMU (CMU_NS, CMU_S)
55 AES (RADIOAES_NS, RADIOAES_S)
56 IADC (IADC0_NS, IADC0_S)
57 MSC (MSC_NS, MSC_S)
58 DPLL0 (DPLL0_NS, DPLL0_S)
60 DCDC (DCDC_NS, DCDC_S)
61 VDAC (VDAC0_NS, VDAC0_S)
62 PCNT0 (PCNT0_NS, PCNT0_S)
63 USB (USB_NS_APBS, USB_S_APBS)
64 SW0 (SYSCFG_NS, SYSCFG_NS_CFGNS, SYSCFG_S, SYSCFG_S_CFGNS)
65 SW1 (SYSCFG_NS, SYSCFG_NS_CFGNS, SYSCFG_S, SYSCFG_S_CFGNS)
66 SW2 (SYSCFG_NS, SYSCFG_NS_CFGNS, SYSCFG_S, SYSCFG_S_CFGNS)
67 SW3 (SYSCFG_NS, SYSCFG_NS_CFGNS, SYSCFG_S, SYSCFG_S_CFGNS)
73 SETAMPERHOST (SEMAILBOX_NS_HOST, SEMAILBOX_S_HOST)
74 SEMBRX (SEMAILBOX_NS_HOST, SEMAILBOX_S_HOST)
75 SEMBTX (SEMAILBOX_NS_HOST, SEMAILBOX_S_HOST)
76 LESENSE (LESENSE_NS, LESENSE_S)
77 SYSRTC_APP (SYSRTC0_NS, SYSRTC0_S)
78 SYSRTC_SEQ (SYSRTC0_NS, SYSRTC0_S)
81 RFFPLL (RFFPLL0_NS, RFFPLL0_S)
82 USBPLL0 (USBPLL0_NS, USBPLL0_S)

## Further device data
name=Copyright 2026 Silicon Laboratories, Inc., ramBaseAddress=0x20000000, ramSize=0x00080000, ramAccessTypes=rwx, seqram_s_BaseAddress=0xA0000000, seqram_s_Size=0x00006000, seqram_s_AccessTypes=rwx, frcram_s_BaseAddress=0xA0006000, frcram_s_Size=0x00001000, frcram_s_AccessTypes=rwx, new_mem_s_BaseAddress=0xA2000000, new_mem_s_Size=0x02000000, new_mem_s_AccessTypes=rwx, mem_s_BaseAddress=0xA5000000, mem_s_Size=0x00010000, mem_s_AccessTypes=rwx, ram_s_BaseAddress=0xA6800000, ram_s_Size=0x00002000, ram_s_AccessTypes=rwx, seqram_ns_BaseAddress=0xB0000000, seqram_ns_Size=0x00006000, seqram_ns_AccessTypes=rwx, frcram_ns_BaseAddress=0xB0006000, frcram_ns_Size=0x00001000, frcram_ns_AccessTypes=rwx, new_mem_ns_BaseAddress=0xB2000000, new_mem_ns_Size=0x02000000, new_mem_ns_AccessTypes=rwx, mem_ns_BaseAddress=0xB5000000, mem_ns_Size=0x00010000, mem_ns_AccessTypes=rwx, ram_ns_BaseAddress=0xB6800000, ram_ns_Size=0x00002000, ram_ns_AccessTypes=rwx
