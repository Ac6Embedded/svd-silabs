# SIMG301M113WIH register map
Vendor: Silicon Labs; Series: Si; File version: B
"Ikea" Part
Registers are 32-bit, read-write, reset 0x0 unless marked. A register's access mark holds for its fields unless they carry their own. Offsets are from the block's base; lines under a group give offsets from that group; [hi:lo] are bit positions; {n}, {i} and the like mark numbered series; 'fields as' and 'values as' point back to an identical list; <NAME> marks a mode.

## Memory map
0x0FE08000 DEVINFO_NS size 0x1000 — DEVINFO_NS Registers
0x1FE08000 DEVINFO_S size 0x1000 — DEVINFO_S Registers
0x40000000 LETIMER0_NS size 0x1000 — LETIMER0_NS Registers
0x40004000 ADC0_NS size 0x1000 — ADC0_NS Registers
0x40008000 ACMP0_NS size 0x1000 — ACMP0_NS Registers
0x4000C000 ACMP1_NS size 0x1000 — ACMP1_NS Registers
0x40040000 PCNT0_NS size 0x1000 — PCNT0_NS Registers
0x40100000 HFRCOEM23_NS size 0x1000 — HFRCOEM23_NS Registers
0x40104000 HFXO0_NS size 0x1000 — HFXO0_NS Registers
0x40200000 I2C0_NS size 0x1000 — I2C0_NS Registers
0x40204000 WDOG0_NS size 0x1000 — WDOG0_NS Registers
0x40208000 EUSART0_NS size 0x1000 — EUSART0_NS Registers
0x40800000 SOCPLL0_NS size 0x1000 — SOCPLL0_NS Registers
0x40804000 CMU_NS size 0x1000 — CMU_NS Registers
0x40808000 DMEM_NS size 0x1000 — DMEM_NS Registers
0x40810000 HFRCO0_NS size 0x1000 — HFRCO0_NS Registers
0x40814000 LDMA0_NS size 0x1000 — LDMA0_NS Registers
0x40818000 FSRCO_NS size 0x1000 — FSRCO_NS Registers
0x4081C000 DPLL0_NS size 0x1000 — DPLL0_NS Registers
0x40820000 LFXO_NS size 0x1000 — LFXO_NS Registers
0x40824000 LFRCO_NS size 0x1000 — LFRCO_NS Registers
0x40828000 ULFRCO_NS size 0x1000 — ULFRCO_NS Registers
0x4082C000 SEMAPHORE0_NS size 0x1000 — SEMAPHORE0_NS Registers
0x40830000 SEMAPHORE1_NS size 0x1000 — SEMAPHORE1_NS Registers
0x40834000 L1ICACHE0_NS size 0x1000 — L1ICACHE0_NS Registers
0x40838000 PRS_NS size 0x1000 — PRS_NS Registers
0x4083C000 GPIO_NS size 0x1000 — GPIO_NS Registers
0x40844000 LDMAXBAR0_NS size 0x1000 — LDMAXBAR0_NS Registers
0x40848000 TIMER0_NS size 0x1000 — TIMER0_NS Registers
0x4084C000 TIMER1_NS size 0x1000 — TIMER1_NS Registers
0x40850000 TIMER2_NS size 0x1000 — TIMER2_NS Registers
0x40854000 TIMER3_NS size 0x1000 — TIMER3_NS Registers
0x40858000 ETAMPDET_NS size 0x1000 — ETAMPDET_NS Registers
0x4085C000 L2ICACHE0_NS size 0x1000 — L2ICACHE0_NS Registers
0x40860000 PIXELRZ0_NS size 0x1000 — PIXELRZ0_NS Registers
0x40864000 BURTC_NS size 0x1000 — BURTC_NS Registers
0x40868000 I2C1_NS size 0x1000 — I2C1_NS Registers
0x40870000 SYSCFG_NS_CFGNS size 0x1000 — SYSCFG_NS_CFGNS Registers
0x40874000 SYSCFG_NS size 0x1000 — SYSCFG_NS Registers
0x40878000 BURAM_NS size 0x1000 — BURAM_NS Registers
0x4087C000 GPCRC0_NS size 0x1000 — GPCRC0_NS Registers
0x40880000 LEDDRV0_NS size 0x1000 — LEDDRV0_NS Registers
0x40884000 EUSART1_NS size 0x1000 — EUSART1_NS Registers
0x40888000 EUSART2_NS size 0x1000 — EUSART2_NS Registers
0x4088C000 PIXELRZ1_NS size 0x1000 — PIXELRZ1_NS Registers
0x40890000 I2C2_NS size 0x1000 — I2C2_NS Registers
0x40894000 WDOG1_NS size 0x1000 — WDOG1_NS Registers
0x40898000 RPA_NS size 0x1000 — RPA_NS Registers
0x4089C000 KSU_NS size 0x1000 — KSU_NS Registers
0x41000000 SYMCRYPTO_NS size 0x1000 — SYMCRYPTO_NS Registers
0x41004000 LPWAES_NS size 0x1000 — LPWAES_NS Registers
0x41008000 SMU_NS size 0x1000 — SMU_NS Registers
0x4100C000 SMU_NS_CFGNS size 0x1000 — SMU_NS_CFGNS Registers
0x42800000 SEMAILBOX_NS_HOST size 0x1000 — SEMAILBOX_NS_HOST Registers
0x50000000 LETIMER0_S size 0x1000 — LETIMER0_S Registers
0x50004000 ADC0_S size 0x1000 — ADC0_S Registers
0x50008000 ACMP0_S size 0x1000 — ACMP0_S Registers
0x5000C000 ACMP1_S size 0x1000 — ACMP1_S Registers
0x50040000 PCNT0_S size 0x1000 — PCNT0_S Registers
0x50100000 HFRCOEM23_S size 0x1000 — HFRCOEM23_S Registers
0x50104000 HFXO0_S size 0x1000 — HFXO0_S Registers
0x50200000 I2C0_S size 0x1000 — I2C0_S Registers
0x50204000 WDOG0_S size 0x1000 — WDOG0_S Registers
0x50208000 EUSART0_S size 0x1000 — EUSART0_S Registers
0x50800000 SOCPLL0_S size 0x1000 — SOCPLL0_S Registers
0x50804000 CMU_S size 0x1000 — CMU_S Registers
0x50808000 DMEM_S size 0x1000 — DMEM_S Registers
0x50810000 HFRCO0_S size 0x1000 — HFRCO0_S Registers
0x50814000 LDMA0_S size 0x1000 — LDMA0_S Registers
0x50818000 FSRCO_S size 0x1000 — FSRCO_S Registers
0x5081C000 DPLL0_S size 0x1000 — DPLL0_S Registers
0x50820000 LFXO_S size 0x1000 — LFXO_S Registers
0x50824000 LFRCO_S size 0x1000 — LFRCO_S Registers
0x50828000 ULFRCO_S size 0x1000 — ULFRCO_S Registers
0x5082C000 SEMAPHORE0_S size 0x1000 — SEMAPHORE0_S Registers
0x50830000 SEMAPHORE1_S size 0x1000 — SEMAPHORE1_S Registers
0x50834000 L1ICACHE0_S size 0x1000 — L1ICACHE0_S Registers
0x50838000 PRS_S size 0x1000 — PRS_S Registers
0x5083C000 GPIO_S size 0x1000 — GPIO_S Registers
0x50844000 LDMAXBAR0_S size 0x1000 — LDMAXBAR0_S Registers
0x50848000 TIMER0_S size 0x1000 — TIMER0_S Registers
0x5084C000 TIMER1_S size 0x1000 — TIMER1_S Registers
0x50850000 TIMER2_S size 0x1000 — TIMER2_S Registers
0x50854000 TIMER3_S size 0x1000 — TIMER3_S Registers
0x50858000 ETAMPDET_S size 0x1000 — ETAMPDET_S Registers
0x5085C000 L2ICACHE0_S size 0x1000 — L2ICACHE0_S Registers
0x50860000 PIXELRZ0_S size 0x1000 — PIXELRZ0_S Registers
0x50864000 BURTC_S size 0x1000 — BURTC_S Registers
0x50868000 I2C1_S size 0x1000 — I2C1_S Registers
0x50870000 SYSCFG_S_CFGNS size 0x1000 — SYSCFG_S_CFGNS Registers
0x50874000 SYSCFG_S size 0x1000 — SYSCFG_S Registers
0x50878000 BURAM_S size 0x1000 — BURAM_S Registers
0x5087C000 GPCRC0_S size 0x1000 — GPCRC0_S Registers
0x50880000 LEDDRV0_S size 0x1000 — LEDDRV0_S Registers
0x50884000 EUSART1_S size 0x1000 — EUSART1_S Registers
0x50888000 EUSART2_S size 0x1000 — EUSART2_S Registers
0x5088C000 PIXELRZ1_S size 0x1000 — PIXELRZ1_S Registers
0x50890000 I2C2_S size 0x1000 — I2C2_S Registers
0x50894000 WDOG1_S size 0x1000 — WDOG1_S Registers
0x50898000 RPA_S size 0x1000 — RPA_S Registers
0x5089C000 KSU_S size 0x1000 — KSU_S Registers
0x51000000 SYMCRYPTO_S size 0x1000 — SYMCRYPTO_S Registers
0x51004000 LPWAES_S size 0x1000 — LPWAES_S Registers
0x51008000 SMU_S size 0x1000 — SMU_S Registers
0x5100C000 SMU_S_CFGNS size 0x1000 — SMU_S_CFGNS Registers
0x52800000 SEMAILBOX_S_HOST size 0x1000 — SEMAILBOX_S_HOST Registers
0xA3000000 SYSRTC0_NS size 0x1000 — SYSRTC0_NS Registers
0xA3004000 SCRATCHPAD_NS size 0x1000 — SCRATCHPAD_NS Registers
0xA3008000 EMU_NS size 0x1000 — EMU_NS Registers
0xA300C000 EMU_NS_CFGNS size 0x1000 — EMU_NS_CFGNS Registers
0xA3010000 SEPORTAL_NS size 0x1000 — SEPORTAL_NS Registers
0xA3014000 LPW0PORTAL_NS size 0x1000 — LPW0PORTAL_NS Registers
0xA3018000 HOSTPORTAL_NS size 0x1000 — HOSTPORTAL_NS Registers
0xB3000000 SYSRTC0_S size 0x1000 — SYSRTC0_S Registers
0xB3004000 SCRATCHPAD_S size 0x1000 — SCRATCHPAD_S Registers
0xB3008000 EMU_S size 0x1000 — EMU_S Registers
0xB300C000 EMU_S_CFGNS size 0x1000 — EMU_S_CFGNS Registers
0xB3010000 SEPORTAL_S size 0x1000 — SEPORTAL_S Registers
0xB3014000 LPW0PORTAL_S size 0x1000 — LPW0PORTAL_S Registers
0xB3018000 HOSTPORTAL_S size 0x1000 — HOSTPORTAL_S Registers

## Interrupts
0 SETAMPERHOST (SEMAILBOX_NS_HOST, SEMAILBOX_S_HOST)
1 SEMBRX (SEMAILBOX_NS_HOST, SEMAILBOX_S_HOST)
2 SEMBTX (SEMAILBOX_NS_HOST, SEMAILBOX_S_HOST)
3 SMU_SECURE (SMU_NS, SMU_NS_CFGNS, SMU_S, SMU_S_CFGNS)
4 SMU_S_PRIVILEGED (SMU_NS, SMU_NS_CFGNS, SMU_S, SMU_S_CFGNS)
6 EMU (EMU_NS, EMU_NS_CFGNS, EMU_S, EMU_S_CFGNS)
7 EMUDG (EMU_NS, EMU_NS_CFGNS, EMU_S, EMU_S_CFGNS)
9 ETAMPDET (ETAMPDET_NS, ETAMPDET_S)
10 TIMER0 (TIMER0_NS, TIMER0_S)
11 TIMER1 (TIMER1_NS, TIMER1_S)
12 TIMER2 (TIMER2_NS, TIMER2_S)
13 TIMER3 (TIMER3_NS, TIMER3_S)
14 SYSRTC_SEQ (SYSRTC0_NS, SYSRTC0_S)
15 SYSRTC_APP (SYSRTC0_NS, SYSRTC0_S)
16 SYSRTC_MS (SYSRTC0_NS, SYSRTC0_S)
17 EUSART0_RX (EUSART0_NS, EUSART0_S)
18 EUSART0_TX (EUSART0_NS, EUSART0_S)
19 EUSART1_RX (EUSART1_NS, EUSART1_S)
20 EUSART1_TX (EUSART1_NS, EUSART1_S)
21 EUSART2_RX (EUSART2_NS, EUSART2_S)
22 EUSART2_TX (EUSART2_NS, EUSART2_S)
23 L1ICACHE0 (L1ICACHE0_NS, L1ICACHE0_S)
24 L2ICACHE0 (L2ICACHE0_NS, L2ICACHE0_S)
25 BURTC (BURTC_NS, BURTC_S)
26 LETIMER0 (LETIMER0_NS, LETIMER0_S)
27 PIXELRZ0 (PIXELRZ0_NS, PIXELRZ0_S)
28 PIXELRZ1 (PIXELRZ1_NS, PIXELRZ1_S)
29 SYSCFG (SYSCFG_NS, SYSCFG_NS_CFGNS, SYSCFG_S, SYSCFG_S_CFGNS)
30 DMEM (DMEM_NS, DMEM_S)
{n+31} LDMA0_CHNL{n} (LDMA0_NS, LDMA0_S) (n=0..7)
39 LFXO (LFXO_NS, LFXO_S)
40 LFRCO (LFRCO_NS, LFRCO_S)
41 ULFRCO (ULFRCO_NS, ULFRCO_S)
42 GPIO_ODD (GPIO_NS, GPIO_S)
43 GPIO_EVEN (GPIO_NS, GPIO_S)
44 I2C0 (I2C0_NS, I2C0_S)
45 I2C1 (I2C1_NS, I2C1_S)
46 I2C2 (I2C2_NS, I2C2_S)
62 ACMP0 (ACMP0_NS, ACMP0_S)
63 ACMP1 (ACMP1_NS, ACMP1_S)
64 WDOG0 (WDOG0_NS, WDOG0_S)
65 WDOG1 (WDOG1_NS, WDOG1_S)
66 HFXO0 (HFXO0_NS, HFXO0_S)
67 HFRCO0 (HFRCO0_NS, HFRCO0_S)
68 HFRCOEM23 (HFRCOEM23_NS, HFRCOEM23_S)
69 CMU (CMU_NS, CMU_S)
70 RPA (RPA_NS, RPA_S)
71 KSURPA (KSU_NS, KSU_S)
72 KSULPWAES (KSU_NS, KSU_S)
73 KSUHOSTSYMCRYPTO (KSU_NS, KSU_S)
74 SYMCRYPTO (SYMCRYPTO_NS, SYMCRYPTO_S)
75 LPWAES (LPWAES_NS, LPWAES_S)
76 ADC0 (ADC0_NS, ADC0_S)
77 LEDDRV0 (LEDDRV0_NS, LEDDRV0_S)
78 DPLL0 (DPLL0_NS, DPLL0_S)
79 SOCPLL0 (SOCPLL0_NS, SOCPLL0_S)
80 PCNT0 (PCNT0_NS, PCNT0_S)
81 SW0 (SYSCFG_NS, SYSCFG_NS_CFGNS, SYSCFG_S, SYSCFG_S_CFGNS)
82 SW1 (SYSCFG_NS, SYSCFG_NS_CFGNS, SYSCFG_S, SYSCFG_S_CFGNS)
83 SW2 (SYSCFG_NS, SYSCFG_NS_CFGNS, SYSCFG_S, SYSCFG_S_CFGNS)
84 SW3 (SYSCFG_NS, SYSCFG_NS_CFGNS, SYSCFG_S, SYSCFG_S_CFGNS)

## Further device data
name=Copyright 2026 Silicon Laboratories, Inc., port0_s_BaseAddress=0x10800000, port0_s_Size=0x00080000, port0_s_AccessTypes=rwx, port0_s_BaseAddress=0x11000000, port0_s_Size=0x08000000, port0_s_AccessTypes=rwx, port0_instr_ns_BaseAddress=0x00800000, port0_instr_ns_Size=0x00080000, port0_instr_ns_AccessTypes=rwx, port0_instr_ns_BaseAddress=0x01000000, port0_instr_ns_Size=0x08000000, port0_instr_ns_AccessTypes=rwx, port1_s_BaseAddress=0x30000000, port1_s_Size=0x00080000, port1_s_AccessTypes=rwx, port1_ns_BaseAddress=0x20000000, port1_ns_Size=0x00080000, port1_ns_AccessTypes=rwx, slaxi_port_s_BaseAddress=0x51C00000, slaxi_port_s_Size=0x00000280, slaxi_port_s_AccessTypes=rwx, slaxi_port_ns_BaseAddress=0x41C00000, slaxi_port_ns_Size=0x00000280, slaxi_port_ns_AccessTypes=rwx, port0_s_BaseAddress=0x71000000, port0_s_Size=0x08000000, port0_s_AccessTypes=rwx, port0_ns_BaseAddress=0x61000000, port0_ns_Size=0x08000000, port0_ns_AccessTypes=rwx
