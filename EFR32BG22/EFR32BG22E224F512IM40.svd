# EFR32BG22E224F512IM40 register map
Vendor: Silicon Labs; Series: EFR32; File version: F
Does not exist (yet), it was created for CMSIS generation purposes; Blue Gecko, QFN40, Energy Harvesting, 76.8 MHz, 2.4G, 6dB, Long Range PHY Rates (125 kbps and 500 kbps) PFLRCO, BLE, 512kB, 32kB(RAM), 26 GPIO, 125 C
Registers are 32-bit, read-write, reset 0x0 unless marked. A register's access mark holds for its fields unless they carry their own. Offsets are from the block's base; lines under a group give offsets from that group; [hi:lo] are bit positions; {n}, {i} and the like mark numbered series; 'fields as' and 'values as' point back to an identical list; <NAME> marks a mode.

## Memory map
0x0FE08000 DEVINFO size 0x1000 — DEVINFO Registers
0x40004000 EMU_S size 0x1000 — EMU_S Registers
0x40008000 CMU_S size 0x1000 — CMU_S Registers
0x4000C000 HFXO0_S size 0x1000 — HFXO0_S Registers
0x40010000 HFRCO0_S size 0x1000 — HFRCO0_S Registers
0x40018000 FSRCO_S size 0x1000 — FSRCO_S Registers
0x4001C000 DPLL0_S size 0x1000 — DPLL0_S Registers
0x40020000 LFXO_S size 0x1000 — LFXO_S Registers
0x40024000 LFRCO_S size 0x1000 — LFRCO_S Registers
0x40028000 ULFRCO_S size 0x1000 — ULFRCO_S Registers
0x40030000 MSC_S size 0x1000 — MSC_S Registers
0x40034000 ICACHE0_S size 0x1000 — ICACHE0_S Registers
0x40038000 PRS_S size 0x1000 — PRS_S Registers
0x4003C000 GPIO_S size 0x1000 — GPIO_S Registers
0x40040000 LDMA_S size 0x1000 — LDMA_S Registers
0x40044000 LDMAXBAR_S size 0x1000 — LDMAXBAR_S Registers
0x40048000 TIMER0_S size 0x1000 — TIMER0_S Registers
0x4004C000 TIMER1_S size 0x1000 — TIMER1_S Registers
0x40050000 TIMER2_S size 0x1000 — TIMER2_S Registers
0x40054000 TIMER3_S size 0x1000 — TIMER3_S Registers
0x40058000 TIMER4_S size 0x1000 — TIMER4_S Registers
0x4005C000 USART0_S size 0x1000 — USART0_S Registers
0x40060000 USART1_S size 0x1000 — USART1_S Registers
0x40064000 BURTC_S size 0x1000 — BURTC_S Registers
0x40068000 I2C1_S size 0x1000 — I2C1_S Registers
0x40078000 SYSCFG_S_CFGNS size 0x1000 — SYSCFG_S_CFGNS Registers
0x4007C000 SYSCFG_S size 0x1000 — SYSCFG_S Registers
0x40080000 BURAM_S size 0x1000 — BURAM_S Registers
0x40088000 GPCRC_S size 0x1000 — GPCRC_S Registers
0x40094000 DCDC_S size 0x1000 — DCDC_S Registers
0x40098000 PDM_S size 0x1000 — PDM_S Registers
0x44000000 RADIOAES_S size 0x1000 — RADIOAES_S Registers
0x44008000 SMU_S size 0x1000 — SMU_S Registers
0x4400C000 SMU_S_CFGNS size 0x1000 — SMU_S_CFGNS Registers
0x48000000 RTCC_S size 0x1000 — RTCC_S Registers
0x4A000000 LETIMER0_S size 0x1000 — LETIMER0_S Registers
0x4A004000 IADC0_S size 0x1000 — IADC0_S Registers
0x4A010000 I2C0_S size 0x1000 — I2C0_S Registers
0x4A018000 WDOG0_S size 0x1000 — WDOG0_S Registers
0x4A030000 EUART0_S size 0x1000 — EUART0_S Registers
0x4C020000 CRYPTOACC_S size 0x1000 — CRYPTOACC_S Registers
0x4C021000 CRYPTOACC_S_RNGCTRL size 0x1000 — CRYPTOACC_S_RNGCTRL Registers
0x4C022000 CRYPTOACC_S_PKCTRL size 0x1000 — CRYPTOACC_S_PKCTRL Registers
0x50004000 EMU_NS size 0x1000 — EMU_NS Registers
0x50008000 CMU_NS size 0x1000 — CMU_NS Registers
0x5000C000 HFXO0_NS size 0x1000 — HFXO0_NS Registers
0x50010000 HFRCO0_NS size 0x1000 — HFRCO0_NS Registers
0x50018000 FSRCO_NS size 0x1000 — FSRCO_NS Registers
0x5001C000 DPLL0_NS size 0x1000 — DPLL0_NS Registers
0x50020000 LFXO_NS size 0x1000 — LFXO_NS Registers
0x50024000 LFRCO_NS size 0x1000 — LFRCO_NS Registers
0x50028000 ULFRCO_NS size 0x1000 — ULFRCO_NS Registers
0x50030000 MSC_NS size 0x1000 — MSC_NS Registers
0x50034000 ICACHE0_NS size 0x1000 — ICACHE0_NS Registers
0x50038000 PRS_NS size 0x1000 — PRS_NS Registers
0x5003C000 GPIO_NS size 0x1000 — GPIO_NS Registers
0x50040000 LDMA_NS size 0x1000 — LDMA_NS Registers
0x50044000 LDMAXBAR_NS size 0x1000 — LDMAXBAR_NS Registers
0x50048000 TIMER0_NS size 0x1000 — TIMER0_NS Registers
0x5004C000 TIMER1_NS size 0x1000 — TIMER1_NS Registers
0x50050000 TIMER2_NS size 0x1000 — TIMER2_NS Registers
0x50054000 TIMER3_NS size 0x1000 — TIMER3_NS Registers
0x50058000 TIMER4_NS size 0x1000 — TIMER4_NS Registers
0x5005C000 USART0_NS size 0x1000 — USART0_NS Registers
0x50060000 USART1_NS size 0x1000 — USART1_NS Registers
0x50064000 BURTC_NS size 0x1000 — BURTC_NS Registers
0x50068000 I2C1_NS size 0x1000 — I2C1_NS Registers
0x50078000 SYSCFG_NS_CFGNS size 0x1000 — SYSCFG_NS_CFGNS Registers
0x5007C000 SYSCFG_NS size 0x1000 — SYSCFG_NS Registers
0x50080000 BURAM_NS size 0x1000 — BURAM_NS Registers
0x50088000 GPCRC_NS size 0x1000 — GPCRC_NS Registers
0x50094000 DCDC_NS size 0x1000 — DCDC_NS Registers
0x50098000 PDM_NS size 0x1000 — PDM_NS Registers
0x54000000 RADIOAES_NS size 0x1000 — RADIOAES_NS Registers
0x54008000 SMU_NS size 0x1000 — SMU_NS Registers
0x5400C000 SMU_NS_CFGNS size 0x1000 — SMU_NS_CFGNS Registers
0x58000000 RTCC_NS size 0x1000 — RTCC_NS Registers
0x5A000000 LETIMER0_NS size 0x1000 — LETIMER0_NS Registers
0x5A004000 IADC0_NS size 0x1000 — IADC0_NS Registers
0x5A010000 I2C0_NS size 0x1000 — I2C0_NS Registers
0x5A018000 WDOG0_NS size 0x1000 — WDOG0_NS Registers
0x5A030000 EUART0_NS size 0x1000 — EUART0_NS Registers
0x5C020000 CRYPTOACC_NS size 0x1000 — CRYPTOACC_NS Registers
0x5C021000 CRYPTOACC_NS_RNGCTRL size 0x1000 — CRYPTOACC_NS_RNGCTRL Registers
0x5C022000 CRYPTOACC_NS_PKCTRL size 0x1000 — CRYPTOACC_NS_PKCTRL Registers
0xA8000000 PRORTC_S size 0x1000 — PRORTC_S Registers
0xB8000000 PRORTC_NS size 0x1000 — PRORTC_NS Registers

## Interrupts
0 CRYPTOACC (CRYPTOACC_NS, CRYPTOACC_NS_PKCTRL, CRYPTOACC_NS_RNGCTRL, CRYPTOACC_S, CRYPTOACC_S_PKCTRL, CRYPTOACC_S_RNGCTRL)
1 TRNG (CRYPTOACC_NS, CRYPTOACC_NS_PKCTRL, CRYPTOACC_NS_RNGCTRL, CRYPTOACC_S, CRYPTOACC_S_PKCTRL, CRYPTOACC_S_RNGCTRL)
2 PKE (CRYPTOACC_NS, CRYPTOACC_NS_PKCTRL, CRYPTOACC_NS_RNGCTRL, CRYPTOACC_S, CRYPTOACC_S_PKCTRL, CRYPTOACC_S_RNGCTRL)
3 SMU_SECURE (SMU_NS, SMU_NS_CFGNS, SMU_S, SMU_S_CFGNS)
4 SMU_S_PRIVILEGED (SMU_NS, SMU_NS_CFGNS, SMU_S, SMU_S_CFGNS)
6 EMU (EMU_NS, EMU_S)
7 TIMER0 (TIMER0_NS, TIMER0_S)
8 TIMER1 (TIMER1_NS, TIMER1_S)
9 TIMER2 (TIMER2_NS, TIMER2_S)
10 TIMER3 (TIMER3_NS, TIMER3_S)
11 TIMER4 (TIMER4_NS, TIMER4_S)
12 RTCC (RTCC_NS, RTCC_S)
13 USART0_RX (USART0_NS, USART0_S)
14 USART0_TX (USART0_NS, USART0_S)
15 USART1_RX (USART1_NS, USART1_S)
16 USART1_TX (USART1_NS, USART1_S)
17 ICACHE0 (ICACHE0_NS, ICACHE0_S)
18 BURTC (BURTC_NS, BURTC_S)
19 LETIMER0 (LETIMER0_NS, LETIMER0_S)
20 SYSCFG (SYSCFG_NS, SYSCFG_NS_CFGNS, SYSCFG_S, SYSCFG_S_CFGNS)
21 LDMA (LDMA_NS, LDMA_S)
22 LFXO (LFXO_NS, LFXO_S)
23 LFRCO (LFRCO_NS, LFRCO_S)
24 ULFRCO (ULFRCO_NS, ULFRCO_S)
25 GPIO_ODD (GPIO_NS, GPIO_S)
26 GPIO_EVEN (GPIO_NS, GPIO_S)
27 I2C0 (I2C0_NS, I2C0_S)
28 I2C1 (I2C1_NS, I2C1_S)
29 EMUDG (EMU_NS, EMU_S)
30 EMUSE (EMU_NS, EMU_S)
41 PRORTC (PRORTC_NS, PRORTC_S)
43 WDOG0 (WDOG0_NS, WDOG0_S)
44 HFXO0 (HFXO0_NS, HFXO0_S)
45 HFRCO0 (HFRCO0_NS, HFRCO0_S)
46 CMU (CMU_NS, CMU_S)
47 AES (RADIOAES_NS, RADIOAES_S)
48 IADC (IADC0_NS, IADC0_S)
49 MSC (MSC_NS, MSC_S)
50 DPLL0 (DPLL0_NS, DPLL0_S)
51 PDM (PDM_NS, PDM_S)
52 SW0 (SYSCFG_NS, SYSCFG_NS_CFGNS, SYSCFG_S, SYSCFG_S_CFGNS)
53 SW1 (SYSCFG_NS, SYSCFG_NS_CFGNS, SYSCFG_S, SYSCFG_S_CFGNS)
54 SW2 (SYSCFG_NS, SYSCFG_NS_CFGNS, SYSCFG_S, SYSCFG_S_CFGNS)
55 SW3 (SYSCFG_NS, SYSCFG_NS_CFGNS, SYSCFG_S, SYSCFG_S_CFGNS)
61 DCDC (DCDC_NS, DCDC_S)
62 EUART0_RX (EUART0_NS, EUART0_S)
63 EUART0_TX (EUART0_NS, EUART0_S)

## Further device data
name=Copyright 2026 Silicon Laboratories, Inc., flashBaseAddress=0x00000000, flashSize=0x00080000, flashAccessTypes=rx, userdataBaseAddress=0x0FE00000, userdataSize=0x00000400, userdataAccessTypes=rx, devinfoBaseAddress=0x0FE08000, devinfoSize=0x00000400, devinfoAccessTypes=rx, chipconfigBaseAddress=0x0FE0E000, chipconfigSize=0x00000600, chipconfigAccessTypes=rx, ramBaseAddress=0x20000000, ramSize=0x00008000, ramAccessTypes=rwx, fifo_s_BaseAddress=0x4C024000, fifo_s_Size=0x00004000, fifo_s_AccessTypes=rwx, cryptoacc_s_BaseAddress=0x4C028000, cryptoacc_s_Size=0x00001000, cryptoacc_s_AccessTypes=rwx, fifo_ns_BaseAddress=0x5C024000, fifo_ns_Size=0x00004000, fifo_ns_AccessTypes=rwx, cryptoacc_ns_BaseAddress=0x5C028000, cryptoacc_ns_Size=0x00001000, cryptoacc_ns_AccessTypes=rwx, seqram_s_BaseAddress=0xA0000000, seqram_s_Size=0x00004000, seqram_s_AccessTypes=rwx, frcram_s_BaseAddress=0xA0004000, frcram_s_Size=0x00001000, frcram_s_AccessTypes=rwx, seqram_ns_BaseAddress=0xB0000000, seqram_ns_Size=0x00004000, seqram_ns_AccessTypes=rwx, frcram_ns_BaseAddress=0xB0004000, frcram_ns_Size=0x00001000, frcram_ns_AccessTypes=rwx
